/*
 * Copyright (c) 2019 Linaro Limited
 *
 * SPDX-License-Identifier: Apache-2.0
 */

&arduino_spi {
	adxl372@0 {
		compatible = "adi,adxl372";
		reg = <0>;
		spi-max-frequency = <8000000>;
		label = "ADXL372";
		int-gpios = <&gpioa 10 0>;
	};
};
