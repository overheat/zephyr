/*
 * Copyright (c) 2019 Linaro Limited
 *
 * SPDX-License-Identifier: Apache-2.0
 */

&i2c0 {
	apds9960@29 {
		compatible = "avago,apds9960";
		reg = <0x29>;
		label = "APDS9960";
		int-gpios = <&gpio0 23 0>;
	};
};
